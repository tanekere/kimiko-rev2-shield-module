#include "kimiko_rev2.dtsi"

&kscan0 {
    col-gpios
        = <&gpio0 22 GPIO_ACTIVE_HIGH> // Col 0 from PCB
        , <&gpio0 24 GPIO_ACTIVE_HIGH> // Col 1 from PCB
        , <&gpio1 00 GPIO_ACTIVE_HIGH> // Col 2 from PCB
        , <&gpio0 11 GPIO_ACTIVE_HIGH> // Col 3 from PCB
        , <&gpio1 04 GPIO_ACTIVE_HIGH> // Col 4 from PCB
        , <&gpio1 06 GPIO_ACTIVE_HIGH> // Col 5 from PCB
        ;
};

&left_encoder {
    status = "okay";
};