#include "kimiko_rev2.dtsi"

&default_transform { // The matrix transform for this board is 8 columns over because the left half is 8 columns wide according to the matrix.
    col-offset = <8>;
};

&kscan0 {
    col-gpios
        = <&gpio1 06 GPIO_ACTIVE_HIGH> // Col 5 from PCB
        , <&gpio1 04 GPIO_ACTIVE_HIGH> // Col 4 from PCB
        , <&gpio0 11 GPIO_ACTIVE_HIGH> // Col 3 from PCB
        , <&gpio1 00 GPIO_ACTIVE_HIGH> // Col 2 from PCB
        , <&gpio0 24 GPIO_ACTIVE_HIGH> // Col 1 from PCB
        , <&gpio0 22 GPIO_ACTIVE_HIGH> // Col 0 from PCB
        ;
};

&right_encoder {
    status = "okay";
};